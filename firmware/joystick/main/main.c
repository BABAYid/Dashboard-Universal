// ============================================================================
//  main.c — модуль ввода приборной панели: джойстик BMW iDrive.
//
//  Что делает модуль: держит джойстик BMW F20/F30 «живым» на CAN и превращает
//  его нажатия и повороты в кадр 0x530 для приборки (протокол 1.4).
//
//  Схема работы — две задачи, и это не украшательство:
//
//      task_can_rx — ждёт кадры от джойстика (0x267, 0x264) и габариты из
//                    0x200, разбирает их и кладёт события в очередь на
//                    отправку. Только принимает, в шину сама не пишет.
//      task_can_tx — разливает очередь в шину, шлёт heartbeat 0x563 каждые
//                    100 мс, повторяет пробуждение 0x273 по тишине и следит
//                    за состоянием контроллера (bus-off).
//
//  Почему не одна задача: приём блокируется до 20 мс в ожидании кадра, а
//  heartbeat обязан уходить каждые 100 мс. Одна задача ещё как-то успевала бы,
//  но при всплеске событий (прокрутка энкодера) передача встала бы за приёмом;
//  на двух задачах приём никогда не ждёт передачу, а передача — приём.
//
//  Что модуль НЕ делает: не читает провода машины (это блок сбора), не трогает
//  кадры 0x100…0x7F0 и не отвечает на 0x5E7 — по протоколу 1.4 это чужая
//  территория.
// ============================================================================
#include "esp_log.h"
#include "freertos/FreeRTOS.h"
#include "freertos/task.h"

#include "bmw_joystick.h"
#include "can_bus.h"
#include "config.h"

static const char *TAG = "input";

// Счётчик в байте 3 кадра 0x530: переполняется сам на 255, как требует
// протокол. Отдельный счётчик событий (не обрезанный) — только для журнала.
static uint8_t  s_event_seq;
static uint32_t s_event_total;

// ---------------------------------------------------------------------------
//  Публикация события приборке — кадр 0x530
//
//  Раскладка (can_protocol_v1.4.txt):
//      байт 0 — вид события: 0x01 кнопка, 0x02 энкодер
//      байт 1 — код кнопки; для энкодера 0
//      байт 2 — кнопка: 1 нажата / 0 отпущена; энкодер: знаковая дельта int8
//      байт 3 — счётчик событий 0…255
//      байт 4–7 — 0
//
//  Шлём и нажатие, и отпускание: приборка сейчас реагирует на нажатие, но
//  отпускание ей нужно, чтобы понимать, что кнопку уже отпустили (иначе
//  удержание и повтор не отличить от одиночного нажатия).
// ---------------------------------------------------------------------------
static void publish_event(const input_event_t *event)
{
    uint8_t frame[CAN_FRAME_BYTES] = { 0 };
    frame[0] = event->kind;
    frame[1] = event->code;
    frame[2] = (uint8_t)event->value;   // для энкодера это int8 в байте
    frame[3] = s_event_seq++;

    // В очередь, а не сразу в контроллер: задача приёма не должна ждать, пока
    // освободится шина, иначе следующие кадры джойстика потеряются.
    const bool queued = can_bus_send(CAN_ID_INPUT_EVENT, frame);
    ++s_event_total;

    if (event->kind == IN_EVENT_BUTTON) {
        ESP_LOGI(TAG, "0x267: кнопка %s %s → 0x530 %02X %02X %02X %02X%s",
                 joy_button_name(event->code),
                 (event->value != 0) ? "нажата" : "отпущена",
                 frame[0], frame[1], frame[2], frame[3],
                 queued ? "" : "  (очередь переполнена, кадр потерян)");
    } else {
        ESP_LOGI(TAG, "0x264: энкодер %+d → 0x530 %02X %02X %02X %02X%s",
                 (int)event->value,
                 frame[0], frame[1], frame[2], frame[3],
                 queued ? "" : "  (очередь переполнена, кадр потерян)");
    }
}

// ---------------------------------------------------------------------------
//  Задача приёма
// ---------------------------------------------------------------------------
static void task_can_rx(void *arg)
{
    (void)arg;

    for (;;) {
        // Шины нет (например, отвалился трансивер и задачу передачи ещё не
        // успели поднять шину) — просто ждём, не крутя цикл вхолостую.
        if (!can_bus_is_ready()) {
            vTaskDelay(pdMS_TO_TICKS(100));
            continue;
        }

        uint32_t id = 0;
        uint8_t  dlc = 0;
        uint8_t  data[CAN_FRAME_BYTES];

        // Таймаут приёма — это норма: джойстик молчит, пока его не трогают.
        if (!can_bus_receive(&id, &dlc, data, CAN_RX_WAIT_MS))
            continue;

        input_event_t event;
        if (joy_handle_frame(id, dlc, data, &event))
            publish_event(&event);
    }
}

// ---------------------------------------------------------------------------
//  Задача передачи
// ---------------------------------------------------------------------------
static void task_can_tx(void *arg)
{
    (void)arg;
    TickType_t last_status = xTaskGetTickCount();

    for (;;) {
        // Шина не поднялась при старте — пробуем снова. Причина обычно
        // железная (нет питания трансивера, модуль не вставлен в разъём),
        // и после её устранения модуль должен ожить сам, без перезагрузки.
        if (!can_bus_is_ready()) {
            if (can_bus_init() != ESP_OK) {
                ESP_LOGW(TAG, "CAN не поднимается, повтор через секунду");
                vTaskDelay(pdMS_TO_TICKS(1000));
                last_status = xTaskGetTickCount();
                continue;
            }
        }

        // 1. Разливаем очередь событий. Первый кадр ждём до 10 мс (проснёмся
        //    сразу, как только появится событие), остальные забираем без
        //    ожидания: пачка событий должна уйти пачкой, пока шина свободна.
        can_frame_t frame;
        if (can_bus_tx_wait(&frame, CAN_TX_TICK_MS)) {
            do {
                can_bus_transmit(frame.id, frame.data);
            } while (can_bus_tx_wait(&frame, 0));
        }

        // 2. Жизнеобеспечение джойстика: 0x563 каждые 100 мс и 0x273 по тишине.
        joy_periodic();

        // 3. Состояние контроллера и подъём шины после bus-off.
        can_bus_poll();

        // 4. Раз в несколько секунд — счётчики и состояние шины. Единственная
        //    регулярная строка лога: по ней на столе видно, жива ли связь.
        if (xTaskGetTickCount() - last_status >= pdMS_TO_TICKS(STATUS_LOG_MS)) {
            last_status = xTaskGetTickCount();
            ESP_LOGI(TAG, "шина %s | отправлено %u, принято %u, потеряно %u, "
                          "ошибок шины %u | событий %u",
                     can_bus_state_name(),
                     (unsigned)can_bus_frames_sent(),
                     (unsigned)can_bus_frames_received(),
                     (unsigned)can_bus_frames_dropped(),
                     (unsigned)can_bus_error_count(),
                     (unsigned)s_event_total);
        }
    }
}

// ---------------------------------------------------------------------------
//  Запуск
// ---------------------------------------------------------------------------
void app_main(void)
{
    ESP_LOGI(TAG, "=== Модуль ввода: джойстик BMW iDrive (F20/F30) ===");
    ESP_LOGI(TAG, "прошивка %d.%d, протокол приборки 1.4, кадр событий 0x530",
             FW_VERSION_MAJOR, FW_VERSION_MINOR);
    ESP_LOGI(TAG, "CAN: %d кбит/с, 11-бит ID, 8 байт, TX=GPIO%d, RX=GPIO%d",
             CAN_BITRATE_KBPS, PIN_CAN_TX, PIN_CAN_RX);
    ESP_LOGI(TAG, "джойстику: 0x563 каждые %d мс, 0x273 при старте и после "
                  "%d мс тишины, 0x202 по фронту габаритов",
             JOY_HEARTBEAT_MS, JOY_WAKE_RETRY_MS);

    if (can_bus_init() != ESP_OK) {
        // Не повод не запускаться: задача передачи продолжит попытки, а в
        // журнале будет видно, что дело в шине, а не в логике.
        ESP_LOGE(TAG, "CAN не поднялся при старте — задача передачи будет "
                      "пробовать заново");
    }

    // Пробуждение джойстика при старте. Если шины ещё нет, кадр не уйдёт —
    // его повторит joy_periodic() из задачи передачи через 2 секунды.
    joy_init();

    xTaskCreate(task_can_rx, "can_rx", APP_TASK_STACK_CAN, NULL,
                APP_TASK_PRIORITY_CAN_RX, NULL);
    xTaskCreate(task_can_tx, "can_tx", APP_TASK_STACK_CAN, NULL,
                APP_TASK_PRIORITY_CAN_TX, NULL);
}
